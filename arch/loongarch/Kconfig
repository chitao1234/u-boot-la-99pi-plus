## arch/loongarch/Kconfig
```kconfig
menu "LOONGARCH architecture"
	depends on LOONGARCH

config SYS_ARCH
	default "loongarch"

choice
	prompt "CPU selection"
	default CPU_LOONGARCH64

config CPU_LOONGARCH32
	bool "LOONGARCH32"
	select SUPPORTS_CPU_LOONGARCH32
	select 32BIT
	help
	  Choose this option to build an U-Boot for LOONGARCH32 architecture.

config CPU_LOONGARCH64
	bool "LOONGARCH64"
	select SUPPORTS_CPU_LOONGARCH64
	select 64BIT
	help
	  Choose this option to build a U-Boot for LOONGARCH64 architecture.

endchoice

choice 
	prompt "Target select"
	optional

config ARCH_LA_LOONGSON
	bool "Support Loongson LA platform"
	select OF_CONTROL
	select OF_LIBFDT
	select DM
	select DM_SERIAL
	imply DISPLAY_CPUINFO
	imply CMD_DM
	select SUPPORT_SPL
	select SPL_OF_CONTROL if SPL_DM
	select SPL_DM_SERIAL if SPL_DM
	help
	  This supports loongson platform

endchoice

source "arch/loongarch/mach-loongson/Kconfig"

menu "General setup"

config ROM_EXCEPTION_VECTORS
	bool "Build U-Boot image with exception vectors"
	help
	  Enable this to include exception vectors in the U-Boot image. This is
	  required if the U-Boot entry point is equal to the address of the
	  CPU reset exception vector (e.g. U-Boot as ROM loader in Qemu,
	  U-Boot booted from parallel NOR flash).
	  Disable this, if the U-Boot image is booted from DRAM (e.g. by SPL).
	  In that case the image size will be reduced by 0x500 bytes.

endmenu

menu "OS boot interface"

config LOONGARCH_BOOT_CMDLINE_LEGACY
	bool "Hand over legacy command line to Linux kernel"
	default y
	help
	  Enable this option if you want U-Boot to hand over the Yamon-style
	  command line to the kernel. All bootargs will be prepared as argc/argv
	  compatible list. The argument count (argc) is stored in register $a0.
	  The address of the argument list (argv) is stored in register $a1.


config LOONGARCH_BOOT_FDT
	bool "Hand over a flattened device tree to Linux kernel"
	default n
	help
	  Enable this option if you want U-Boot to hand over a flattened
	  device tree to the kernel. According to UHI register $a0 will be set
	  to -2 and the FDT address is stored in $a1.

endmenu

config SUPPORTS_CPU_LOONGARCH32
	bool

config SUPPORTS_CPU_LOONGARCH64
	bool

config 32BIT
	bool

config 64BIT
	bool

config DMA_ADDR_T_64BIT
	bool
	default y if 64BIT
	help
	 Select this to enable 64-bit DMA addressing

config SYS_DCACHE_SIZE
	int
	default 0
	help
	  The total size of the L1 Dcache, if known at compile time.

config SYS_DCACHE_LINE_SIZE
	int
	default 0
	help
	  The size of L1 Dcache lines, if known at compile time.

config SYS_ICACHE_SIZE
	int
	default 0
	help
	  The total size of the L1 ICache, if known at compile time.

config SYS_ICACHE_LINE_SIZE
	int
	default 0
	help
	  The size of L1 Icache lines, if known at compile time.

config SYS_SCACHE_LINE_SIZE
	int
	default 0
	help
	  The size of L2 cache lines, if known at compile time.


config SYS_CACHE_SIZE_AUTO
	def_bool y if SYS_DCACHE_SIZE = 0 && SYS_ICACHE_SIZE = 0 && \
		SYS_DCACHE_LINE_SIZE = 0 && SYS_ICACHE_LINE_SIZE = 0 && \
		SYS_SCACHE_LINE_SIZE = 0
	help
	  Select this (or let it be auto-selected by not defining any cache
	  sizes) in order to allow U-Boot to automatically detect the sizes
	  of caches at runtime. This has a small cost in code size & runtime
	  so if you know the cache configuration for your system at compile
	  time it would be beneficial to configure it.

config LOONGARCH_L1_CACHE_SHIFT_4
	bool

config LOONGARCH_L1_CACHE_SHIFT_5
	bool

config LOONGARCH_L1_CACHE_SHIFT_6
	bool

config LOONGARCH_L1_CACHE_SHIFT_7
	bool

config LOONGARCH_L1_CACHE_SHIFT
	int
	default "7" if LOONGARCH_L1_CACHE_SHIFT_7
	default "6" if LOONGARCH_L1_CACHE_SHIFT_6
	default "5" if LOONGARCH_L1_CACHE_SHIFT_5
	default "4" if LOONGARCH_L1_CACHE_SHIFT_4
	default "6"

config LOONGARCH_L2_CACHE
	bool
	help
	  Select this if your system includes an L2 cache and you want U-Boot
	  to initialise & maintain it.

endmenu
```

## arch/loongarch/mach-loongson/Kconfig
```kconfig
menu "Loongson setup"
choice
	prompt "Loongson soc family select"
	depends on ARCH_LA_LOONGSON

config SOC_LS2K0300
	bool "Support for LS2K0300 family SoCs"
	depends on SUPPORTS_CPU_LOONGARCH64
	select LOONGARCH_L1_CACHE_SHIFT_6

endchoice

choice
	prompt "CPU freq select"
	depends on ARCH_LA_LOONGSON

config CPU_500MHZ
	bool "500MHz"

config CPU_600MHZ
	bool "600MHz"

config CPU_700MHZ
	bool "700MHz"

config CPU_800MHZ
	bool "800MHz"
	depends on SOC_LS2K0300

config CPU_900MHZ
	bool "900MHz"
	depends on SOC_LS2K0300

config CPU_1000MHZ
	bool "1000MHz"
	depends on SOC_LS2K0300

config CPU_1100MHZ
	bool "1100MHz"
	depends on SOC_LS2K0300
endchoice

choice
	prompt "Board select"
	default TARGET_LS2K0300 if SOC_LS2K0300
config TARGET_LS2K0300
	bool "LS2K0300 Board"
	depends on SOC_LS2K0300
	help
	  This supports Loongson 2K0300 board.

endchoice

config SYS_CPU
	default "LA264" if SOC_LS2K0300

config SYS_SOC
	default "ls2k0300" if SOC_LS2K0300

config CPU_FREQ
	int
	default 500 if CPU_500MHZ
	default 600 if CPU_600MHZ
	default 700 if CPU_700MHZ
	default 800 if CPU_800MHZ
	default 900 if CPU_900MHZ
	default 1000 if CPU_1000MHZ
	default 1100 if CPU_1100MHZ

source "board/loongson/Kconfig"

endmenu
```

## board/loongson/Kconfig
```kconfig
config MACH_LOONGSON
	bool
	default y if ARCH_LA_LOONGSON
	select LAST_STAGE_INIT
	select SPL_BOARD_INIT if SPL

config SYS_VENDOR
	default "loongson"

if SOC_LS2K0300
config SYS_BOARD
	default "ls2k0300"

config SYS_CONFIG_NAME
	default "loongson_2k0300"

endif

source "board/loongson/common/Kconfig"
```

## board/loongson/common/Kconfig
```kconfig
menu "Loongson common options"

config LOONGSON_COMPAT
	bool "Loongson multi-boards compatibility support"
	default n
	depends on MACH_LOONGSON
	select FIT if !SPL
	select MULTI_DTB_FIT if !SPL
	select DTB_RESELECT if !SPL
	select SPL_OF_CONTROL if SPL
	select SPL_OF_REAL if SPL
	select SPL_FIT if SPL
	select SPL_LOAD_FIT if SPL
	select SPL_MULTI_DTB_FIT if SPL
	select BOARD_TYPES

config LOONGSON_BOOT_FIXUP
	bool "Fixup Loongson boot param before boot kernel."
	default y
	depends on MACH_LOONGSON

config LOONGSON_RECOVER
	bool "Enable the featrue Recovering system from usb/mmc/sata."
	default n
	depends on MACH_LOONGSON

config LOONGSON_KEYHANDLE_FAIL_CONTINUE_BOOT
	bool "If Press-Key-Auto-Update fail, Enable the featrue to continue boot."
	default n
	depends on MACH_LOONGSON

config LOONGSON_VIDCONSOLE_NOTICE
    bool "Show Notice Under logo"
    default y

config LOONGSON_GENERAL_LOAD
    bool "Enable general_load Command"
    default n
    select CMD_UNZIP

endmenu
```
